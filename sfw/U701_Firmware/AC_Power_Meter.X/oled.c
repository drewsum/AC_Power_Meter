
#include "oled.h"

I2C1_MESSAGE_STATUS OLED_I2C_Status;

const uint8_t OledFont[][8] = 
{
    {0x00,0x00,0x00,0x00,0x00,0x00,0x00,0x00},
    {0x00,0x00,0x5F,0x00,0x00,0x00,0x00,0x00},
    {0x00,0x00,0x07,0x00,0x07,0x00,0x00,0x00},
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    {0x00,0x02,0x05,0x05,0x02,0x00,0x00,0x00},
};




// Send OLED Command Function
void OLED_Command(uint8_t temp) {

    uint8_t length;
    
    uint8_t data_array[2];
    data_array[0] = 0x00;
    data_array[1] = temp;
    
    // length = sizeof(data_array);
    length = 2;

    I2C1_MasterWrite(data_array, length, OLED_ADDR, &OLED_I2C_Status);

    while(OLED_I2C_Status == I2C1_MESSAGE_PENDING);

    if (OLED_I2C_Status == I2C1_MESSAGE_FAIL) {
        error_handler.I2C_COMM_error_flag = true;
    }

    
}

// Send OLED Data function
void OLED_Data(uint8_t temp) {
    
    uint8_t length;
    
    uint8_t data_array[2];
    data_array[0] = 0x40;
    data_array[1] = temp;
    
    // length = sizeof(data_array);
    length = 2;
    
    I2C1_MasterWrite(data_array, length, OLED_ADDR, &OLED_I2C_Status);

    while(OLED_I2C_Status == I2C1_MESSAGE_PENDING);

    if (OLED_I2C_Status == I2C1_MESSAGE_FAIL) {
        error_handler.I2C_COMM_error_flag = true;
    }
   
}

void OLED_Init(void) {
 
    OLED_Command(OLED_DISPLAYOFF);
    //__delay_ms(20);
    OLED_Command(OLED_SETDISPLAYCLOCKDIV);
    //__delay_ms(20);
    OLED_Command(0x80);
    //__delay_ms(20);
    OLED_Command(OLED_SETMULTIPLEX);
    //__delay_ms(20);
    OLED_Command(0x1F);
    //__delay_ms(20);
    OLED_Command(OLED_SETDISPLAYOFFSET);
    //__delay_ms(20);
    OLED_Command(0x0);
    //__delay_ms(20);
    OLED_Command(OLED_SETSTARTLINE | 0x0);
    //__delay_ms(20);
    OLED_Command(OLED_CHARGEPUMP);
    //__delay_ms(20);
    OLED_Command(0xAF);
    //__delay_ms(20);
    OLED_Command(OLED_MEMORYMODE);
    //__delay_ms(20);
    OLED_Command(0x00);
    //__delay_ms(20);
    OLED_Command(OLED_SEGREMAP | 0x1);
    //__delay_ms(20);
    OLED_Command(OLED_COMSCANDEC);
    //__delay_ms(20);
    OLED_Command(OLED_SETCOMPINS);
    //__delay_ms(20);
    OLED_Command(0x02);
    //__delay_ms(20);
    OLED_Command(OLED_SETCONTRAST);
    //__delay_ms(20);
    OLED_Command(0x8F);
    //__delay_ms(20);
    OLED_Command(OLED_SETPRECHARGE);
    //__delay_ms(20);
    OLED_Command(0xF1);
    //__delay_ms(20);
    OLED_Command(OLED_SETVCOMDETECT);
    //__delay_ms(20);
    OLED_Command(0x40);
    //__delay_ms(20);
    OLED_Command(OLED_DISPLAYALLON_RESUME);
    //__delay_ms(20);
    OLED_Command(OLED_NORMALDISPLAY);
    //__delay_ms(20);
    OLED_Command(OLED_DISPLAYON);
    //__delay_ms(20);
    
    NOP();
    
    
}

void OLED_YX(unsigned char Row, unsigned char Column) {
    
    OLED_Command(0xB0 + Row);
    //__delay_ms(20);
    OLED_Command(0x00 + (8 * Column & 0x0F));
    //__delay_ms(20);
    OLED_Command(0x10 + ((8* Column >> 4) & 0x0F));
    //__delay_ms(20);
    
}

void OLED_PutChar(char ch) {
    
    if((ch < 32) || (ch > 127)) {
     
        ch = ' ';
        
    }

    uint8_t length;
    
    uint8_t data_array[9];
    
    data_array[0] = 0x40;
    
    const uint8_t *input_base = &OledFont[ch - 32][0];
    
    memmove(data_array + 1, input_base, 8);
    
    // length = sizeof(data_array);
    length = 9;
        
    I2C1_MasterWrite(data_array, length, OLED_ADDR, &OLED_I2C_Status);

    while(OLED_I2C_Status == I2C1_MESSAGE_PENDING);

    if (OLED_I2C_Status == I2C1_MESSAGE_FAIL) {
        error_handler.I2C_COMM_error_flag = true;
    }

}
    
void OLED_Clear(void) {
 
    for(uint16_t row = 0; row < 8; row++) {
     
        for(uint16_t col = 0; col < 16; col++) {
         
            OLED_PutChar('\0');
            
        }
        
    }
    
    
}

void OLED_Write_String(char* s) {
 
    while(*s) {
     
        OLED_PutChar(*s++);
        
    }
    
    
}

void OLED_Write_Integer(uint16_t i) {
 
    char s[20];
    itoa(s,i,10);
    OLED_Write_String(s);
    OLED_Write_String("");
    
}

void OLED_Write_Float(float f) {
 
    char* buf11;
    int status11;
    
    buf11 = ftoa(f, &status11);
    
    OLED_Write_String(buf11);
    OLED_Write_String("");
    
}

